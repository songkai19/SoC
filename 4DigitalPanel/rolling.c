/*
*功能：数码管滚得显示																  *
*说明：数码管上0.1.2.3滚动显示														  *
*硬件连接：在J4处插上跳线帽  第一位数码管 位引脚-->P2.0								  *
*							 第二位数码管 位引脚-->P2.1								  *
*							 第三位数码管 位引脚-->P2.2								  *
*							 第四位数码管 位引脚-->P2.3								  *
*							 所有的数码管 段引脚-->P0								  *
*作者：研发中心																		  *
*公司：科睿电子产品有限公司 														  *
*电话：0530-2897239   15192459227			  										  *
*地址：菏泽市开发区广州路与淮河路交叉口科睿电子产品有限公司 						  */

#include <reg52.h>

typedef  unsigned char	 uchar ;
typedef  unsigned char	 uint  ;

uchar code table[]={0xc0,0xf9,0xa4,0xb0,0x99,0x92,0x82,0xf8,0x80,0x90,0xbf};
uchar code LED_W[8] = {0xFE,0xFD,0xFB,0xF7,4,5,6,7};
uint Time_temp = 0, LED_temp = 0;
/********************************************************************
* 名称 : Delay_1ms()
* 功能 : 延时子程序，延时时间为 1ms * x
* 输入 : x (延时一毫秒的个数)
* 输出 : 无
***********************************************************************/
void Delay(uint i)
{
	uchar x,j;
	for(j=0;j<i;j++)
	for(x=0;x<=148;x++);	
}

/********************************************************************
* 名称 : Time0_Init()
* 功能 : 定时器的初始化，11.0592MZ晶振，50ms
* 输入 : 无
* 输出 : 无
***********************************************************************/
void Time0_Init()
{
	TMOD = 0x01;
	IE 	 = 0x82;
	TH0  = 0x4c;
	TL0  = 0x00;	
	TR0 = 1;		
}

/********************************************************************
* 名称 : Time0_Int()
* 功能 : 定时器中断，中断中实现 Count 加一
* 输入 : 无
* 输出 : 无
***********************************************************************/
void Time0_Int() interrupt 1
{
	TH0 = 0x4c;
	TL0 = 0x00;
	Time_temp++;
	if(Time_temp == 4)		 //定时器溢出时间50毫秒，隔0.2秒，数码管的数据改变一次
	{
		LED_temp++;
		Time_temp = 0;
	} 			
}

/********************************************************************
* 名称 : Main()
* 功能 : 数码管的显示
* 输入 : 无
* 输出 : 无
***********************************************************************/
void Main(void)
{
	uchar i = 0,j = 0;
	Time0_Init();
	while(1)
	{
		P0 = table[(LED_temp+i) % 4];		//数码管段值
		P2 = LED_W[j];						//点亮某一位数码管
		Delay(2);
		j++;
		i++;
		if(j == 4)							//每个数码管都点亮了一次。
		{
			j = 0;
			i = 0;
		}
	}
}